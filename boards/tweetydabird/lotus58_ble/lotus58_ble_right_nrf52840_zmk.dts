// Copyright (c) 2026 Oscar Brandt
// SPDX-License-Identifier: MIT

#include "lotus58_ble.dtsi"
#include "lotus58_ble_zmk.dtsi"

// This offsets the keyboard matrix, so the right half actually types the desired keys.
&default_transform {
	col-offset = <6>;
};

// Enables the encoder on the right half.
&right_encoder {
	status = "okay";
};

// Enables the status LED on the right half.
&indicator_led {
	status = "okay";
};
