// Copyright (c) 2026 Oscar Brandt
// SPDX-License-Identifier: MIT

#include "lotus58_ble.dtsi"
#include "lotus58_ble_zmk.dtsi"

// Enables the encoder on the left half.
&left_encoder {
	status = "okay";
};

// Enables the status LED on the left half.
&indicator_led {
	status = "okay";
};
