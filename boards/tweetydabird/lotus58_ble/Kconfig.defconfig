## boards/tweetydabird/lotus58_ble/Kconfig.defconfig
```kconfig
# SPDX-License-Identifier: MIT

if BOARD_LOTUS58_BLE_LEFT

config ZMK_KEYBOARD_NAME
	default "Lotus58 BLE"

config ZMK_SPLIT_ROLE_CENTRAL
	default y

endif # BOARD_LOTUS58_BLE_LEFT

if BOARD_LOTUS58_BLE_LEFT || BOARD_LOTUS58_BLE_RIGHT

config BOARD
	default "lotus58_ble"

config ZMK_SPLIT
	default y

config BT_CTLR
	default BT

if USB

config USB_NRFX
	default y

config USB_DEVICE_STACK
	default y

endif # USB

endif # BOARD_LOTUS58_BLE_LEFT || BOARD_LOTUS58_BLE_RIGHT
```

## boards/tweetydabird/lotus58_ble/Kconfig.lotus58_ble_left
```kconfig
# Copyright (c) 2026 Oscar Brandt
# SPDX-License-Identifier: MIT

config BOARD_LOTUS58_BLE_LEFT
	select SOC_NRF52840_QIAA
	select ZMK_BOARD_COMPAT
```

## boards/tweetydabird/lotus58_ble/Kconfig.lotus58_ble_right
```kconfig
# Copyright (c) 2026 Oscar Brandt
# SPDX-License-Identifier: MIT

config BOARD_LOTUS58_BLE_RIGHT
	select SOC_NRF52840_QIAA
	select ZMK_BOARD_COMPAT
```

## boards/tweetydabird/lotus58_ble/board.yml
```yaml
boards:
  - name: lotus58_ble_left
    vendor: tweetydabird
    revision:
      format: major.minor.patch
      default: 1.20.0
      exact: true
      revisions:
        - name: 1.20.0
        - name: 1.10.0
        - name: 1.00.0
    socs:
      - name: nrf52840
        variants:
          - name: zmk
  - name: lotus58_ble_right
    vendor: tweetydabird
    revision:
      format: major.minor.patch
      default: 1.20.0
      exact: true
      revisions:
        - name: 1.20.0
        - name: 1.10.0
        - name: 1.00.0
    socs:
      - name: nrf52840
        variants:
          - name: zmk
```

## boards/tweetydabird/lotus58_ble/lotus58_ble_left.defconfig
```kconfig
## SPDX-License-Identifier: MIT

# Enable GPIO
CONFIG_GPIO=y

# Enable writing to flash
CONFIG_USE_DT_CODE_PARTITION=y
CONFIG_MPU_ALLOW_FLASH_WRITE=y
CONFIG_NVS=y
CONFIG_SETTINGS_NVS=y
CONFIG_FLASH=y
CONFIG_FLASH_PAGE_LAYOUT=y
CONFIG_FLASH_MAP=y

#Output firmware as UF2 file
CONFIG_BUILD_OUTPUT_UF2=y

# Enable USB
CONFIG_ZMK_USB=y
```

## boards/tweetydabird/lotus58_ble/lotus58_ble_left_nrf52840_defconfig
```kconfig
## SPDX-License-Identifier: MIT

# Enables the memory protection unit
CONFIG_ARM_MPU=y

# Enables GPIO
CONFIG_GPIO=y
```
