// SPDX-License-Identifier: MIT

/ {
	right_encoder: encoder-right {
		compatible = "alps,ec11";
		a-gpios = <&gpio1 11 (GPIO_ACTIVE_HIGH | GPIO_PULL_UP)>;
		b-gpios = <&gpio1 13 (GPIO_ACTIVE_HIGH | GPIO_PULL_UP)>;
		steps = <80>;

		status = "disabled";
	};

	leds {
		compatible = "gpio-leds";
		status_led: status-led {
			gpios = <&gpio1 10 GPIO_ACTIVE_HIGH>;
		};
	};
}
